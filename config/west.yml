## config/west.yml
```yaml
manifest:
  defaults:
    revision: v0.3
  remotes:
  # ZMK Official
    - name: zmkfirmware
      url-base: https://github.com/zmkfirmware
    # Additional modules containing boards/shields/custom code can be listed here as well
    - name: dsifry #new entry
      url-base: https://github.com/dsifry #new entry
    # See https://docs.zephyrproject.org/3.2.0/develop/west/manifest.html#projects
  projects:
    - name: zmk
      remote: zmkfirmware
      import: app/west.yml
    - name: nice-view-mod #new entry
      remote: dsifry #new entry
      revision: main #new entry
  self:
    path: config
```
